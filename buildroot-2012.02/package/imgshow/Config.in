## buildroot-2012.02/package/imgshow/Config.in
```kconfig
config BR2_PACKAGE_IMGSHOW
	bool "imgshow"
	default n
	help
	  Tool to show image.
```

## buildroot-2012.02/target/device/geep/Config.in
```kconfig
menuconfig BR2_TARGET_GEEP
	bool "GEEP Targets"

if BR2_TARGET_GEEP
	config BR2_TARGET_GEEP_DBAN
		bool "Boot And Nuke"
endif
```

## buildroot-2015.02/configs/dban_defconfig
```kconfig
BR2_WGET="wget --passive-ftp -nd"
BR2_BACKUP_SITE="http://buildroot.net/downloads/sources/"
BR2_KERNEL_MIRROR="http://www.kernel.org/pub/"
BR2_CCACHE=y
BR2_CCACHE_DIR="${TOPDIR}/.ccache"
BR2_PACKAGE_OVERRIDE_FILE="$(TOPDIR)/local.mk"
BR2_TOOLCHAIN_BUILDROOT_LARGEFILE=y
BR2_TOOLCHAIN_BUILDROOT_INET_IPV6=y
BR2_TOOLCHAIN_BUILDROOT_INET_RPC=y
BR2_TOOLCHAIN_BUILDROOT_WCHAR=y
BR2_PTHREADS=y
BR2_TOOLCHAIN_BUILDROOT_CXX=y
BR2_TARGET_OPTIMIZATION="-Os -pipe"
BR2_TARGET_GENERIC_HOSTNAME="dban"
BR2_TARGET_GENERIC_ISSUE=""
BR2_ROOTFS_DEVICE_CREATION_DYNAMIC_EUDEV=y
BR2_ROOTFS_SKELETON_CUSTOM=y
BR2_ROOTFS_SKELETON_CUSTOM_PATH="target/dban/skeleton"
BR2_ROOTFS_POST_BUILD_SCRIPT="target/dban/post_build.sh"
BR2_LINUX_KERNEL=y
BR2_LINUX_KERNEL_SAME_AS_HEADERS=y
BR2_LINUX_KERNEL_USE_CUSTOM_CONFIG=y
BR2_LINUX_KERNEL_CUSTOM_CONFIG_FILE="target/dban/linux-3.18.6.config"
BR2_PACKAGE_BUSYBOX_CONFIG="target/dban/busybox.config"
BR2_PACKAGE_BUSYBOX_SHOW_OTHERS=y
BR2_PACKAGE_INFOZIP=y
BR2_PACKAGE_YASM=y
BR2_PACKAGE_MTOOLS=y
BR2_PACKAGE_NTFS_3G=y
BR2_PACKAGE_NTFS_3G_NTFSPROGS=y
BR2_PACKAGE_HWDATA=y
BR2_PACKAGE_LSHW=y
BR2_PACKAGE_PCIUTILS=y
BR2_PACKAGE_USBUTILS=y
BR2_PACKAGE_ZLIB=y
BR2_PACKAGE_JPEG=y
BR2_PACKAGE_EXPAT=y
BR2_PACKAGE_LIBCURL=y
BR2_PACKAGE_CURL=y
BR2_PACKAGE_LIBDAEMON=y
BR2_PACKAGE_NCURSES_TARGET_PANEL=y
BR2_PACKAGE_NCURSES_TARGET_FORM=y
BR2_PACKAGE_NCURSES_TARGET_MENU=y
BR2_PACKAGE_BASH=y
BR2_PACKAGE_DIALOG=y
BR2_PACKAGE_DWIPE=y
BR2_TARGET_ROOTFS_INITRAMFS=y
# BR2_TARGET_ROOTFS_TAR is not set
```

## buildroot-2015.02/package/dwipe/Config.in
```kconfig
config BR2_PACKAGE_DWIPE
	bool "dwipe"
	depends on BR2_PACKAGE_UCLIBC && BR2_PACKAGE_NCURSES
	default n
	help
	  DBAN and EBAN wipe component.
```
